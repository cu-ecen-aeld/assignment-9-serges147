## base_external/package/aesdchar/Config.in
```kconfig
config BR2_PACKAGE_AESDCHAR
	bool "aesdchar"
	help
	  Adds building and installing the aesdchar component.
```

## base_external/package/ldd/Config.in
```kconfig
config BR2_PACKAGE_LDD
	bool "ldd"
	help
	  Adds building and installing the misc-modules and scull components of LDD.
```
